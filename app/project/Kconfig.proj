## app/project/Kconfig.proj
```kconfig
#APP specific configuration.
config BF0_HCPU
    bool
    default y

config CUSTOM_MEM_MAP
    bool 
	select custom_mem_map
	default y    

config XIAOZHI_USING_MQTT
    bool "xiaozhi_using_mqtt"
	default n

config CONFIG_IOT_PROTOCOL_MCP
    bool "using mcp protocol"
	default y 
```
